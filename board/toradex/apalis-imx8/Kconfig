## board/toradex/apalis-imx8/Kconfig
```kconfig
if TARGET_APALIS_IMX8

config SYS_BOARD
	default "apalis-imx8"

config SYS_VENDOR
	default "toradex"

config SYS_CONFIG_NAME
	default "apalis-imx8"

endif
```

## board/toradex/colibri-imx8qxp/Kconfig
```kconfig
if TARGET_COLIBRI_IMX8QXP

config SYS_BOARD
	default "colibri-imx8qxp"

config SYS_VENDOR
	default "toradex"

config SYS_CONFIG_NAME
	default "colibri-imx8qxp"

config TDX_CFG_BLOCK
	default y

config TDX_HAVE_MMC
	default y

config TDX_CFG_BLOCK_DEV
	default "0"

config TDX_CFG_BLOCK_PART
	default "1"

# Toradex config block in eMMC, at the end of 1st "boot sector"
config TDX_CFG_BLOCK_OFFSET
	default "-512"

config TDX_CMD_IMX_MFGR
	bool "Enable factory testing commands for Toradex Colibri iMX8QXP modules"
	help
	  This adds the commands
	    pf8100_otp_prog - Program the OTP fuses on the PMIC PF8100
	  If executed on already fused modules it doesn't change any fuse setting.
	default y

source "board/toradex/common/Kconfig"

endif
```

## board/toradex/colibri_imx7/Kconfig
```kconfig
if TARGET_COLIBRI_IMX7

choice
	prompt "Colibri iMX7S/D variant"
	optional

config TARGET_COLIBRI_IMX7_NAND
	bool "Support Colibri iMX7 Solo 256MB/Dual 512MB (raw NAND) modules"

config TARGET_COLIBRI_IMX7_EMMC
	bool "Support Colibri iMX7 Dual 1GB (eMMC) modules"

endchoice

config SYS_BOARD
	default "colibri_imx7"

config SYS_VENDOR
	default "toradex"

config COLIBRI_IMX7_EXT_PHYCLK
	bool "External oscillator for Ethernet PHY clock provided"
	help
	  Select this if your module provides a external Ethernet PHY
	  clock source.
	default y

config TDX_CFG_BLOCK
	default y

config TDX_CFG_BLOCK_2ND_ETHADDR
	default y

config SYS_CONFIG_NAME
	default "colibri_imx7_tezi_recovery" if (!TARGET_COLIBRI_IMX7_NAND && !TARGET_COLIBRI_IMX7_EMMC)

if TARGET_COLIBRI_IMX7_NAND

config SYS_CONFIG_NAME
	default "colibri_imx7"

config TDX_HAVE_NAND
	default y

config TDX_CFG_BLOCK_OFFSET
	default "2048"

config TDX_CFG_BLOCK_OFFSET2
	default "133120"

endif

if TARGET_COLIBRI_IMX7_EMMC

config SYS_CONFIG_NAME
	default "colibri_imx7_emmc"

config TDX_HAVE_MMC
	default y

config TDX_CFG_BLOCK_DEV
	default "0"

config TDX_CFG_BLOCK_PART
	default "1"

# Toradex config block in eMMC, at the end of 1st "boot sector"
config TDX_CFG_BLOCK_OFFSET
	default "-512"

endif

source "board/toradex/common/Kconfig"

endif
```

## configs/colibri-imx8qxp_defconfig
```kconfig
CONFIG_ARM=y
CONFIG_ARCH_IMX8=y
CONFIG_SYS_MALLOC_F_LEN=0x2000
CONFIG_TARGET_COLIBRI_IMX8QXP=y
CONFIG_IMX_BOOTAUX=y
CONFIG_VIDEO=y
CONFIG_DEFAULT_DEVICE_TREE="fsl-imx8qxp-colibri"
CONFIG_BOOTDELAY=3
CONFIG_VERSION_VARIABLE=y
# CONFIG_DISPLAY_BOARDINFO is not set
CONFIG_BOARD_EARLY_INIT_F=y
CONFIG_HUSH_PARSER=y
# CONFIG_CMD_IMPORTENV is not set
CONFIG_CMD_MEMTEST=y
CONFIG_CMD_MMC=y
CONFIG_CMD_I2C=y
CONFIG_CMD_USB=y
CONFIG_CMD_USB_MASS_STORAGE=y
# CONFIG_CMD_FPGA is not set
CONFIG_CMD_GPIO=y
CONFIG_CMD_DHCP=y
CONFIG_CMD_MII=y
CONFIG_CMD_PING=y
CONFIG_CMD_CACHE=y
CONFIG_CMD_EXT4=y
CONFIG_CMD_EXT4_WRITE=y
CONFIG_CMD_FAT=y
CONFIG_CMD_FS_GENERIC=y
CONFIG_EFI_PARTITION=y
# CONFIG_PARTITION_UUIDS is not set
# CONFIG_BLK is not set
CONFIG_DM_GPIO=y
CONFIG_DM_I2C=y
CONFIG_SYS_I2C_IMX_LPI2C=y
CONFIG_DM_MMC=y
# CONFIG_DM_MMC_OPS is not set
CONFIG_NETDEVICES=y
CONFIG_PINCTRL=y
CONFIG_PINCTRL_IMX8=y
CONFIG_POWER_DOMAIN=y
CONFIG_IMX8_POWER_DOMAIN=y
CONFIG_DM_REGULATOR=y
CONFIG_DM_REGULATOR_FIXED=y
CONFIG_DM_REGULATOR_GPIO=y
CONFIG_DM_SERIAL=y
CONFIG_FSL_LPUART=y
CONFIG_DM_THERMAL=y
CONFIG_IMX_SC_THERMAL=y
CONFIG_USB=y
CONFIG_DM_USB=y
CONFIG_USB_XHCI_HCD=y
CONFIG_USB_EHCI_HCD=y
CONFIG_USB_STORAGE=y
CONFIG_USB_GADGET=y
CONFIG_CI_UDC=y
CONFIG_USB_GADGET_DOWNLOAD=y
CONFIG_G_DNL_MANUFACTURER="FSL"
CONFIG_G_DNL_VENDOR_NUM=0x0525
CONFIG_G_DNL_PRODUCT_NUM=0xa4a5
# CONFIG_EFI_LOADER is not set
```
